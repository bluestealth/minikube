## deploy/iso/minikube-iso/configs/minikube_arm64_efi_defconfig
```kconfig
BR2_aarch64=y
BR2_cortex_a57=y
BR2_CCACHE=y
BR2_OPTIMIZE_2=y
BR2_GLOBAL_PATCH_DIR="$(BR2_EXTERNAL_MINIKUBE_PATH)/board/aarch64-efi/minikube/patches"
BR2_SSP_STRONG=y
BR2_TOOLCHAIN_BUILDROOT_VENDOR="minikube"
BR2_TOOLCHAIN_BUILDROOT_GLIBC=y
BR2_BINUTILS_VERSION_2_33_X=y
BR2_GCC_VERSION_9_X=y
BR2_TOOLCHAIN_BUILDROOT_CXX=y
BR2_GCC_ENABLE_LTO=y
BR2_TARGET_GENERIC_HOSTNAME="minikube"
BR2_TARGET_GENERIC_ISSUE="Welcome to minikube"
BR2_TARGET_GENERIC_PASSWD_SHA512=y
BR2_INIT_SYSTEMD=y
BR2_ROOTFS_DEVICE_TABLE="$(BR2_EXTERNAL_MINIKUBE_PATH)/board/aarch64-efi/minikube/permissions"
BR2_SYSTEM_BIN_SH_BASH=y
# BR2_TARGET_GENERIC_GETTY is not set
BR2_ROOTFS_USERS_TABLES="$(BR2_EXTERNAL_MINIKUBE_PATH)/board/aarch64-efi/minikube/users"
BR2_ROOTFS_OVERLAY="$(BR2_EXTERNAL_MINIKUBE_PATH)/board/aarch64-efi/minikube/rootfs-overlay"
BR2_ROOTFS_POST_BUILD_SCRIPT="$(BR2_EXTERNAL_MINIKUBE_PATH)/board/aarch64-efi/minikube/post-build.sh"
BR2_ROOTFS_POST_IMAGE_SCRIPT="$(BR2_EXTERNAL_MINIKUBE_PATH)/board/aarch64-efi/minikube/post-image.sh"
BR2_LINUX_KERNEL=y
BR2_LINUX_KERNEL_USE_CUSTOM_CONFIG=y
BR2_LINUX_KERNEL_CUSTOM_CONFIG_FILE="$(BR2_EXTERNAL_MINIKUBE_PATH)/board/aarch64-efi/minikube/linux_defconfig"
BR2_LINUX_KERNEL_LZ4=y
BR2_LINUX_KERNEL_NEEDS_HOST_LIBELF=y
BR2_PACKAGE_GZIP=y
BR2_PACKAGE_LZ4=y
BR2_PACKAGE_XZ=y
BR2_PACKAGE_STRACE=y
BR2_PACKAGE_FINDUTILS=y
BR2_PACKAGE_GIT=y
BR2_PACKAGE_JQ=y
BR2_PACKAGE_BTRFS_PROGS=y
BR2_PACKAGE_CIFS_UTILS=y
BR2_PACKAGE_E2TOOLS=y
BR2_PACKAGE_NFS_UTILS=y
BR2_PACKAGE_SSHFS=y
BR2_PACKAGE_XFSPROGS=y
BR2_PACKAGE_LVM2=y
BR2_PACKAGE_LVM2_APP_LIBRARY=y
BR2_PACKAGE_PARTED=y
BR2_PACKAGE_SYSSTAT=y
BR2_PACKAGE_LUAJIT=y
BR2_PACKAGE_CA_CERTIFICATES=y
BR2_PACKAGE_LIBGPGME=y
BR2_PACKAGE_LIBOPENSSL_BIN=y
BR2_PACKAGE_LIBQRENCODE=y
BR2_PACKAGE_JSONCPP=y
BR2_PACKAGE_LIBYAML=y
BR2_PACKAGE_LIBCURL=y
BR2_PACKAGE_LIBCURL_CURL=y
BR2_PACKAGE_ELFUTILS=y
BR2_PACKAGE_LIBB64=y
BR2_PACKAGE_LIBSECCOMP=y
BR2_PACKAGE_BRIDGE_UTILS=y
BR2_PACKAGE_CONNTRACK_TOOLS=y
BR2_PACKAGE_EBTABLES=y
BR2_PACKAGE_ETHTOOL=y
BR2_PACKAGE_IPROUTE2=y
BR2_PACKAGE_IPTABLES=y
BR2_PACKAGE_NFTABLES=y
BR2_PACKAGE_RSYNC=y
BR2_PACKAGE_SOCAT=y
BR2_PACKAGE_SUDO=y
BR2_PACKAGE_ACL=y
BR2_PACKAGE_COREUTILS=y
BR2_PACKAGE_HTOP=y
BR2_PACKAGE_PROCPS_NG=y
BR2_PACKAGE_PSMISC=y
BR2_PACKAGE_SYSTEMD_LOGIND=y
BR2_PACKAGE_SYSTEMD_MACHINED=y
BR2_PACKAGE_TAR=y
BR2_PACKAGE_UTIL_LINUX_NSENTER=y
BR2_PACKAGE_UTIL_LINUX_SCHEDUTILS=y
BR2_TARGET_ROOTFS_CPIO=y
BR2_TARGET_ROOTFS_CPIO_GZIP=y
BR2_TARGET_ROOTFS_EXT2=y
BR2_TARGET_ROOTFS_EXT2_4=y
BR2_TARGET_ROOTFS_EXT2_SIZE="600M"
BR2_TARGET_GRUB2=y
BR2_PACKAGE_HOST_DOSFSTOOLS=y
BR2_PACKAGE_HOST_E2TOOLS=y
BR2_PACKAGE_HOST_GENIMAGE=y
BR2_PACKAGE_HOST_MTOOLS=y
```

## deploy/iso/minikube-iso/package/crun/Config.in
```kconfig
config BR2_PACKAGE_CRUN
	bool "crun"
	depends on BR2_PACKAGE_HOST_GO_TARGET_ARCH_SUPPORTS
	depends on BR2_TOOLCHAIN_HAS_THREADS
	select BR2_PACKAGE_LIBGLIB2
	select BR2_PACKAGE_SYSTEMD
	select BR2_PACKAGE_CONMON
	select BR2_PACKAGE_LIBSECCOMP
	select BR2_PACKAGE_UTIL_LINUX_LIBMOUNT
	select BR2_PACKAGE_HOST_PYTHON3
	select BR2_PACKAGE_YAJL
	select BR2_PACKAGE_LIBTOOL
```

## deploy/iso/minikube-iso/package/docker-amd64-bin/Config.in
```kconfig
config BR2_PACKAGE_DOCKER_AMD64_BIN
	bool "docker-amd64-bin"
	default y
	depends on BR2_x86_64
```

## deploy/iso/minikube-iso/package/docker-arm64-bin/Config.in
```kconfig
config BR2_PACKAGE_DOCKER_ARM64_BIN
	bool "docker-arm64-bin"
	default y
	depends on BR2_aarch64
```

## deploy/iso/minikube-iso/package/gluster/Config.in
```kconfig
config BR2_PACKAGE_GLUSTER
	bool "gluster"
	default y
	depends on BR2_x86_64
	select BR2_PACKAGE_LIBAIO
	select BR2_PACKAGE_LIBURCU
	select BR2_PACKAGE_LIBCURL
	select BR2_PACKAGE_LIBFUSE
	select BR2_PACKAGE_LIBFUSE3
	select BR2_PACKAGE_LIBTIRPC
	select BR2_PACKAGE_LIBXML2
	help
	  Gluster is a scalable, distributed file system that
	  aggregates disk storage resources from multiple servers into
	  a single global namespace.

	  https://www.gluster.org/
```

## deploy/iso/minikube-iso/package/vbox-guest/Config.in
```kconfig
config BR2_PACKAGE_VBOX_GUEST
	bool "vbox-guest"
	default y
	depends on BR2_LINUX_KERNEL
	depends on BR2_x86_64
```
